## Kconfig
```kconfig
menu "I2C Bus Configuration"
  config SENSOR_I2C_BUS_COUNT
    int "Number of I2C Bus"
    range 1 2
    default 1
  menu "Bus0 Configuration"
    depends on (SENSOR_I2C_BUS_COUNT >= 1)
    config I2C0_SDA_IO
      int "SDA IO Pin"
      default 33
    config I2C0_SDA_PULL_UP
      bool "Enable SDA Internal Pull-up"
      default n
    config I2C0_SCL_IO
      int "SCL IO Pin"
      default 32
    config I2C0_SCL_PULL_UP
      bool "Enable SCL Internal Pull-up"
      default n
    config I2C0_FREQ
      int "Clock Frequency, Hz"
      default 100000
  endmenu
  menu "Bus1 Configuration"
    depends on (SENSOR_I2C_BUS_COUNT >= 2)
    config I2C1_SDA_IO
      int "SDA IO Pin"
      default 4
    config I2C1_SDA_PULL_UP
      bool "Enable SDA Internal Pull-up"
      default n
    config I2C1_SCL_IO
      int "SCL IO Pin"
      default 27
    config I2C1_SCL_PULL_UP
      bool "Enable SCL Internal Pull-up"
      default n
    config I2C1_FREQ
      int "Clock Frequency, Hz"
      default 100000
  endmenu
endmenu # "I2C Bus Configuration"

config SENSOR_INA219
  depends on (SENSOR_I2C_BUS_COUNT > 0)
  bool "INA219"
  default n
source "$(ESP32_SENSOR_PATH)/ina219/Kconfig"

config SENSOR_SHT21
  depends on (SENSOR_I2C_BUS_COUNT > 0)
  bool "SHT21"
  default n
source "$(ESP32_SENSOR_PATH)/sht21/Kconfig"

config SENSOR_ADS122C04
  depends on (SENSOR_I2C_BUS_COUNT > 0)
  bool "ADS122C04"
  default y
source "$(ESP32_SENSOR_PATH)/ads122c04/Kconfig"

config SENSOR_TOUCHSCREEN
  depends on (SENSOR_I2C_BUS_COUNT > 0)
  bool "Touchscreen"
  default y
source "$(ESP32_SENSOR_PATH)/touchscreen/Kconfig"

config SENSOR_FLOW_METER
  bool "Flow meter"
  default y
source "$(ESP32_SENSOR_PATH)/flow_meter/Kconfig"

config SENSOR_ICM20600
  bool "ICM-20600"
  default y
source "$(ESP32_SENSOR_PATH)/icm20600/Kconfig"
```

## ads122c04/Kconfig
```kconfig
menu "ADS122C04 Configuration"
    depends on SENSOR_ADS122C04

    choice ADS122C04_PINNED_TO_CORE_CHOICE
        prompt "The cpu core which ADS122C04 sensor run"
        depends on !FREERTOS_UNICORE
        default ADS122C04_PINNED_TO_CORE_1
        help
            Specify the CPU core to run ADS122C04
        config ADS122C04_PINNED_TO_CORE_0
            bool "Core 0 (PRO CPU)"
        config ADS122C04_PINNED_TO_CORE_1
            bool "Core 1 (APP CPU)"
        config ADS122C04_NO_CORE_AFFINITY
            bool "No Affinity (PRO or APP CPU)"
    endchoice
    
    config ADS122C04_TASK_PRIORITY
        int "ADS122C04 Task Priority"
        default 5
        help
            Task priority of the ADS122C04 sensor task

    config ADS122C04_STACK_SIZE
        int "Stack Size of ADS122C04 Task"
        default 2048

    config ADS122C04_I2C_PORT_NUM
        int "I2C Master Bus"
        range 0 1
        default 0
    config ADS122C04_DRDY_IO
        int "ADS122C04 DRDY IO"
        default 36

    config ADS122C04_ADDR_DEV
        hex "I2C Device Address"
        default 0x40

    choice ADS122C04_DATA_INTEGRITY
        prompt "Data Integrity"
        default ADS122C04_DATA_INTEGRITY_INVERT
        config ADS122C04_DATA_INTEGRITY_DISABLE
            bool "Disabled"
        config ADS122C04_DATA_INTEGRITY_INVERT
            bool "Inverted Data"
        config ADS122C04_DATA_INTEGRITY_CRC16
            bool "CRC16"
    endchoice

    choice ADS122C04_PGA_GAIN
        prompt "PGA Gain"
        default ADS122C04_PGA_128
        config ADS122C04_PGA_1
            bool "PGA 1"
        config ADS122C04_PGA_2
            bool "PGA 2"
        config ADS122C04_PGA_4
            bool "PGA 4"
        config ADS122C04_PGA_8
            bool "PGA 8"
        config ADS122C04_PGA_16
            bool "PGA 16"
        config ADS122C04_PGA_32
            bool "PGA 32"
        config ADS122C04_PGA_64
            bool "PGA 64"
        config ADS122C04_PGA_128
            bool "PGA 128"
    endchoice

endmenu # "ADS122C04 Configuration"
```

## flow_meter/Kconfig
```kconfig
menu "Flow meter Configuration"
    depends on SENSOR_FLOW_METER

    config FLOW_METER_PCNT_UNIT
        int "Uses PCNT Peripheral Unit"
        range 0 3
        default 0

    config FLOW_METER_IO_PIN
        int "Flow meter IO pin"
        default 26

    config FLOW_METER_ML_PER_PULSE
        int "milliliter per pulse (Q16 Format)"
        default 30147

    config FLOW_METER_COUNT_ON_BOTH_EDGE
        bool "Count on both rising and falling edges"
        default y

endmenu # "Flow meter Configuration"
```

## icm20600/Kconfig
```kconfig
menu "ICM-20600 Configuration"
    depends on SENSOR_ICM20600

    choice ICM20600_PINNED_TO_CORE_CHOICE
        prompt "The cpu core which ICM20600 sensor run"
        depends on !FREERTOS_UNICORE
        default ICM20600_PINNED_TO_CORE_1
        help
            Specify the CPU core to run ICM-20600
        config ICM20600_PINNED_TO_CORE_0
            bool "Core 0 (PRO CPU)"
        config ICM20600_PINNED_TO_CORE_1
            bool "Core 1 (APP CPU)"
        config ICM20600_NO_CORE_AFFINITY
            bool "No Affinity (PRO or APP CPU)"
    endchoice
    
    config ICM20600_TASK_PRIORITY
        int "ICM-20600 Task Priority"
        default 5
        help
            Task priority of the ICM-20600 sensor task

    config ICM20600_STACK_SIZE
        int "Stack Size of ICM-20600 Task"
        default 2048

    config ICM20600_I2C_PORT_NUM
        int "I2C Master Bus"
        range 0 1
        default 0
    config ICM20600_DRDY_IO
        int "ICM-20600 DRDY IO"
        default 39

    config ICM20600_ADDR_DEV
        hex "I2C Device Address"
        default 0x68

endmenu # "ICM-20600 Configuration"
```

## ina219/Kconfig
```kconfig
menu "INA219 Configuration"
    depends on SENSOR_INA219

    choice INA219_PINNED_TO_CORE_CHOICE
        prompt "The cpu core which INA219 sensor run"
        depends on !FREERTOS_UNICORE
        help
            Specify the CPU core to run INA219
        config INA219_PINNED_TO_CORE_0
            bool "Core 0 (PRO CPU)"
        config INA219_PINNED_TO_CORE_1
            bool "Core 1 (APP CPU)"
        config INA219_NO_CORE_AFFINITY
            bool "No Affinity (PRO or APP CPU)"
    endchoice
    
    config INA219_TASK_PRIORITY
        int "INA219 Task Priority"
        default 5
        
    config INA219_STACK_SIZE
        int "Stack Size of INA219 Task"
        default 2048

    menu "I2C Configuration"
        config INA219_I2C_PORT_NUM
            int "I2C Master port used for INA219 Communication"
            range 0 1
            default 0
        config INA219_I2C_CLK_FREQ
            int "I2C Clock Frequency for INA219"
            default 100000
        config INA219_SDA_IO
            int "INA219 I2C SDA IO"
            default 13
        config INA219_SCL_IO
            int "INA219 I2C SCL IO"
            default 15
    endmenu

    config INA219_DEVICE_COUNT
        int "Number of devices on the I2C Bus"
        range 1 3
        default 1

    menu "INA219 DEV1 Configuration"
        depends on (INA219_DEVICE_COUNT >= 1)
        config INA219_ADDR_DEV1
            hex "I2C Address"
            default 0x40
        config INA219_MODE_DEV1
            int "Mode Setting"
            range 0 7
            default 7
        config INA219_SADC_DEV1
            int "Shunt ADC Setting"
            range 0 15
            default 3
        config INA219_BADC_DEV1
            int "Bus ADC Setting"
            range 0 15
            default 3
        config INA219_PGA_DEV1
            int "PGA Setting"
            range 0 3
            default 3
        config INA219_BUS_DEV1
            int "Bus Voltage Range Setting"
            range 0 1
            default 1
        config INA219_CAL_FS_DEV1
            int "Current/Power Calibration"
            range 0 65535
            default 0
    endmenu

    menu "INA219 DEV2 Configuration"
        depends on (INA219_DEVICE_COUNT >= 2)
        config INA219_ADDR_DEV2
            hex "I2C Address"
            default 0x41
        config INA219_MODE_DEV2
            int "Mode Setting"
            range 0 7
            default 7
        config INA219_SADC_DEV2
            int "Shunt ADC Setting"
            range 0 15
            default 3
        config INA219_BADC_DEV2
            int "Bus ADC Setting"
            range 0 15
            default 3
        config INA219_PGA_DEV2
            int "PGA Setting"
            range 0 3
            default 3
        config INA219_BUS_DEV2
            int "Bus Voltage Range Setting"
            range 0 1
            default 1
        config INA219_CAL_FS_DEV2
            int "Current/Power Calibration"
            range 0 65535
            default 0
    endmenu

    menu "INA219 DEV3 Configuration"
        depends on (INA219_DEVICE_COUNT >= 3)
        config INA219_ADDR_DEV3
            hex "I2C Address"
            default 0x44
        config INA219_MODE_DEV3
            int "Mode Setting"
            range 0 7
            default 7
        config INA219_SADC_DEV3
            int "Shunt ADC Setting"
            range 0 15
            default 3
        config INA219_BADC_DEV3
            int "Bus ADC Setting"
            range 0 15
            default 3
        config INA219_PGA_DEV3
            int "PGA Setting"
            range 0 3
            default 3
        config INA219_BUS_DEV3
            int "Bus Voltage Range Setting"
            range 0 1
            default 1
        config INA219_CAL_FS_DEV3
            int "Current/Power Calibration"
            range 0 65535
            default 0
    endmenu

endmenu
```

## sht21/Kconfig
```kconfig
menu "SHT21 Configuration"
    depends on SENSOR_SHT21

    choice SHT21_PINNED_TO_CORE_CHOICE
    prompt "The cpu core which SHT21 sensor run"
    depends on !FREERTOS_UNICORE
    help
        Specify the CPU core to run SHT21
    config SHT21_PINNED_TO_CORE_0
        bool "Core 0 (PRO CPU)"
    config SHT21_PINNED_TO_CORE_1
        bool "Core 1 (APP CPU)"
    config SHT21_NO_CORE_AFFINITY
        bool "No Affinity (PRO or APP CPU)"
    endchoice
    
    config SHT21_TASK_PRIORITY
        int "SHT21 Task Priority"
        default 5
        help
            Task priority of the SHT21 sensor task

    config SHT21_STACK_SIZE
        int "Stack Size of SHT21 Task"
        default 2048

    config SHT21_POLL_INTERVAL
        int "Temperature and RH measurement interval in second"
        default 1
        
    menu "I2C Configuration"
        config SHT21_I2C_PORT_NUM
            int "I2C Master port used for SHT21 Communication"
            range 0 1
            default 0
        config SHT21_I2C_CLK_FREQ
            int "I2C Clock Frequency for SHT21"
            default 100000
        config SHT21_SDA_IO
            int "SHT21 I2C SDA IO"
            default 22
        config SHT21_SCL_IO
            int "SHT21 I2C SCL IO"
            default 23
    endmenu
    
endmenu
```

## test/ADS122C04/main/Kconfig
```kconfig
menu "ESP32 Sensor Configuration"
source "${ESP32_SENSOR_PATH}/Kconfig"
source "${ESP32_SENSOR_PATH}/ads122c04/Kconfig"
endmenu
```

## test/SHT21/main/Kconfig
```kconfig
menu "ESP32 Sensor Configuration"
source "${ESP32_SENSOR_PATH}/Kconfig"
source "${ESP32_SENSOR_PATH}/sht21/Kconfig"
endmenu
```

## touchscreen/Kconfig
```kconfig
menu "Touchscreen Configuration"
    depends on SENSOR_TOUCHSCREEN

    choice TC_PINNED_TO_CORE_CHOICE
        prompt "The cpu core to run touchscreen"
        depends on !FREERTOS_UNICORE
        default TC_PINNED_TO_CORE_1
        help
            Specify the cpu core to run touch
        config TC_PINNED_TO_CORE_0
            bool "Core 0 (PRO CPU)"
        config TC_PINNED_TO_CORE_1
            bool "Core 1 (APP CPU)"
        config TC_NO_CORE_AFFINITY
            bool "No Affinity (PRO or APP CPU)"
    endchoice

    config TC_TASK_STACK_SIZE
        int "Touch Task Stack Size"
        default 2048

    config TC_TASK_PRIORITY
        int "Touch Task Priority"
        default 1

    choice TC_DRIVER_IC
        prompt "Touch Driver IC"
        config TC_DRIVER_FT6336
            bool "Focaltech FT6336"
        config TC_DRIVER_GT911
            bool "Goodix GT911"
    endchoice

    config TC_I2C_PORT_NUM
        int "I2C Master Bus"
        range 0 1
        default 0
    config TC_SLAVE_ADDR
        hex "Touch IC I2C slave address"
        default 0x38 if TC_DRIVER_FT6336
        default 0x5D if TC_DRIVER_GT911
    config TC_RESET_IO_PIN
        int "Touch IC Reset IO pin"
        default 5
    config TC_INT_IO_PIN
        int "Touch IC Interrupt IO pin"
        default 35
    config TC_INT_PULL_UP
        bool "Enable INT Pin Internal Pull-up"
        default y
    config TC_DRIVER_DEBUG
        bool "Print debug log"
        default y
endmenu
```
